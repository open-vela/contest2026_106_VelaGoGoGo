## app/home_scense/Kconfig
```kconfig
#
# app/home_scense/Kconfig
# Contest 2026 team 106 — home_scense application
#

config LVX_USE_DEMO_CONTEST2026_106_HELLO_APP
	bool "Contest 2026 team 106 home_scense app"
	default n
	select NETUTILS_MQTTC
	---help---
		Enable the contest 2026 team 106 home_scense LVGL application.
		Based on luncher_mini, with modular sensor / LED / UI architecture.

if LVX_USE_DEMO_CONTEST2026_106_HELLO_APP

config LVX_USE_DEMO_CONTEST2026_106_PROGNAME
	string "Program name"
	default "home_scense"

config LVX_USE_DEMO_CONTEST2026_106_PRIORITY
	int "Task priority"
	default 100

config LVX_USE_DEMO_CONTEST2026_106_STACKSIZE
	int "Stack size"
	default 102400

config LVX_USE_DEMO_CONTEST2026_106_TOUCH_DEVPATH
	string "Touchscreen input device"
	default "/dev/input0"
	---help---
		NuttX input event device used by the LVGL touchscreen backend.

config LVX_USE_DEMO_CONTEST2026_106_DOUBAO_VOICE
	bool "Enable Doubao push-to-talk voice assistant"
	default y
	depends on LIB_CURL && CRYPTO_MBEDTLS && AUDIOUTILS_NXAUDIO_LIB
	---help---
		Enable the contest-only Doubao RealtimeAPI voice interaction panel.
		Credentials are compiled locally from ignored doubao_secret.h.

if LVX_USE_DEMO_CONTEST2026_106_DOUBAO_VOICE

config LVX_USE_DEMO_CONTEST2026_106_DOUBAO_CAPTURE_DEV
	string "Doubao microphone device"
	default "/dev/audio/pcm0c"

config LVX_USE_DEMO_CONTEST2026_106_DOUBAO_PLAYBACK_DEV
	string "Doubao speaker device"
	default "/dev/audio/pcm0p"

endif

config LVX_USE_DEMO_CONTEST2026_106_WAKEUP
	bool "Enable hands-free wake-word trigger"
	default y
	depends on LVX_USE_DEMO_CONTEST2026_106_DOUBAO_VOICE
	---help---
		Background wake-word detection (pure-C CNN ported from
		apps/wake_demo). While the Doubao assistant is idle the wake
		thread owns the microphone; on the wake word it releases the mic
		and starts a Doubao session hands-free.

if LVX_USE_DEMO_CONTEST2026_106_WAKEUP

config LVX_USE_DEMO_CONTEST2026_106_WAKEUP_CAPTURE_DEV
	string "Wake-word microphone device"
	default "/dev/audio/pcm0c"

endif

endif
```
